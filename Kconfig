## Kconfig
```kconfig
menu "ATOMVM_LIB Configuration"

config AVM_LIB_ENABLE
	bool  "Enable AtomVM LIB driver"
	default y
	help
		Use this parameter to enable or disable the AtomVM LIB driver.

config RTC_MEMORY_SIZE
	int  "RTC Memory Size (in bytes)"
	default 0
	help
		Use this parameter to set the size of the RTC memory buffer.

endmenu
```
